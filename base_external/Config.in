## base_external/Config.in
```kconfig
mkdir -p base_external/package
cat > base_external/Config.in <<'EOF'
menu "Project Base packages"
    # Add your external packages here; example for aesd-assignments:
    source "$BR2_EXTERNAL_PROJECT_BASE_PATH/package/aesd-assignments/Config.in"
endmenu
EOF
```

## base_external/configs/aesd_qemu_defconfig
```kconfig
BR2_aarch64=y
BR2_TOOLCHAIN_BUILDROOT_GLIBC=y
BR2_TARGET_GENERIC_HOSTNAME="aesd"
BR2_TARGET_GENERIC_ISSUE="AELD QEMU"
BR2_PACKAGE_AESD_ASSIGNMENTS=y
```
